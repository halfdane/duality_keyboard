## particle/zmk-particle-config/config/boards/shields/particle/Kconfig.defconfig
```kconfig
if SHIELD_PARTICLE_LEFT

config ZMK_SPLIT_ROLE_CENTRAL
    default y

endif

if SHIELD_PARTICLE_LEFT || SHIELD_PARTICLE_RIGHT

config ZMK_SPLIT
    default y

config ZMK_KEYBOARD_NAME
    default "Particle"

config ZMK_POINTING
    default y


config I2C
    default y

endif
```

## particle/zmk-particle-config/config/boards/shields/particle/Kconfig.shield
```kconfig
config SHIELD_PARTICLE_LEFT
    def_bool $(shields_list_contains,particle_left)

# No whitespace after the comma or in your part name!
config SHIELD_PARTICLE_RIGHT
    def_bool $(shields_list_contains,particle_right)
```

## particle/zmk-particle-config/config/west.yml
```yaml
manifest:
  remotes:
    - name: zmkfirmware
      url-base: https://github.com/zmkfirmware
    - name: miketronic
      url-base: https://github.com/miketronic/
    - name: halfdane
      url-base: https://github.com/halfdane/
    - name: johanson
      url-base: https://github.com/petejohanson
    - name: miryoku
      url-base: https://github.com/manna-harbour/
  projects:
    - name: zmk
      remote: johanson
      revision: split/wired-split-first-pass
      import: app/west.yml
    - name: zephyr
      remote: johanson
      revision: v3.5.0+zmk-fixes+rp2040-uart-fifo
      import: west.yml
#    - name: zmk
#      remote: halfdane
#      revision: rp2040zero
#      import: app/west.yml
    - name: cirque-input-module
      remote: halfdane
      revision: absolute_mode
    - name: zmk-input-processors
      remote: halfdane
      revision: main
    - name: zmk-input-gestures
      remote: halfdane
      revision: main
    - name: miryoku_zmk
      remote: halfdane
      revision: master
  self: 
    path: config
```

## wave/zmk-wave-config/boards/shields/wave/Kconfig.defconfig
```kconfig
if SHIELD_WAVE_LEFT

# Name must be less than 16 characters long!
config ZMK_KEYBOARD_NAME
    default "Wave"

config ZMK_SPLIT_ROLE_CENTRAL
    default y

endif

if SHIELD_WAVE_LEFT || SHIELD_WAVE_RIGHT

config ZMK_SPLIT
    default y

endif
```

## wave/zmk-wave-config/boards/shields/wave/Kconfig.shield
```kconfig
config SHIELD_WAVE_LEFT
    def_bool $(shields_list_contains,wave_left)

config SHIELD_WAVE_RIGHT
    def_bool $(shields_list_contains,wave_right)

config SHIELD_WAVE_DONGLE
    def_bool $(shields_list_contains,wave_dongle)
```
