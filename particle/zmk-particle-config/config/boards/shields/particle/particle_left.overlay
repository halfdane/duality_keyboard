#include "particle.dtsi"

&kscan0 {
    col-gpios
        = <&gpio0 2 GPIO_ACTIVE_HIGH>
        , <&gpio0 3  GPIO_ACTIVE_HIGH>
        , <&gpio0 4  GPIO_ACTIVE_HIGH>
        , <&gpio0 5  GPIO_ACTIVE_HIGH>
        , <&gpio0 6  GPIO_ACTIVE_HIGH>
        , <&gpio0 7  GPIO_ACTIVE_HIGH>
        ;
};

&uart0_default {
	group1 {
	    pinmux = <UART0_TX_P0>;
	};
	group2 {
	    pinmux = <UART0_RX_P1>;
	    input-enable;
	};
};

