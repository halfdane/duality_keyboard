#define MIRYOKU_LAYOUTMAPPING_FERRIS( \
K00, K01, K02, K03, K04,      K05, K06, K07, K08, K09, \
K10, K11, K12, K13, K14,      K15, K16, K17, K18, K19, \
K20, K21, K22, K23, K24,      K25, K26, K27, K28, K29, \
N30, N31, K32, K33, K34,      K35, K36, K37, N38, N39 \
) \
K00  K01  K02  K03  K04       K05  K06  K07  K08  K09 \
K10  K11  K12  K13  K14       K15  K16  K17  K18  K19 \
K20  K21  K22  K23  K24       K25  K26  K27  K28  K29 \
               K33  K34       K35  K36

#define MIRYOKU_KLUDGE_THUMBCOMBOS_LEFT 30 31
#define MIRYOKU_KLUDGE_THUMBCOMBOS_RIGHT 32 33

#define MIRYOKU_KLUDGE_THUMBCOMBOS

#define MIRYOKU_KLUDGE_MOUSEKEYSPR

#define MIRYOKU_MAPPING MIRYOKU_LAYOUTMAPPING_FERRIS
 
#include "../miryoku_zmk/miryoku/miryoku.dtsi"



// #include <behaviors.dtsi>
// #include <dt-bindings/zmk/keys.h>
// #include <dt-bindings/zmk/bt.h>
// #include <dt-bindings/zmk/outputs.h>
// 
// 
// / {
//   keymap {
//     compatible = "zmk,keymap";
//     LOL {
//       display-name = "lol";
//       bindings = < &bootloader >;
//     };
//   };
// };
// 


